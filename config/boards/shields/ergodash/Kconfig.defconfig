## config/boards/shields/ergodash/Kconfig.defconfig
```kconfig
# Copyright (c) 2020 The ZMK Contributors
# SPDX-License-Identifier: MIT

if SHIELD_ERGODASH_LEFT

config ZMK_KEYBOARD_NAME
    default "Ergodash"

config ZMK_SPLIT_ROLE_CENTRAL
    default y

endif

if SHIELD_ERGODASH_LEFT || SHIELD_ERGODASH_RIGHT

config ZMK_SPLIT
    default y

endif

if ZMK_BACKLIGHT

config PWM
    default y

config LED_PWM
    default y

endif # ZMK_BACKLIGHT
```
