## config/boards/shields/tank/Kconfig.shield
```kconfig
# Copyright (c) 2020 The ZMK Contributors
# SPDX-License-Identifier: MIT

config SHIELD_ERGO_CENTRAL_DONGLE
    def_bool $(shields_list_contains,ergomini_central_dongle)

config SHIELD_ERGO_CENTRAL_LEFT
    def_bool $(shields_list_contains,ergomini_central_left)
    
config SHIELD_ERGO_PERIPHERAL_LEFT
    def_bool $(shields_list_contains,ergomini_peripheral_left)

config SHIELD_ERGO_PERIPHERAL_RIGHT
    def_bool $(shields_list_contains,ergomini_peripheral_right)
```

## config/west.yml
```yaml
manifest:
  remotes:
    - name: zmkfirmware
      url-base: https://github.com/zmkfirmware
    - name: dongle
      url-base: https://github.com/wu-n
  projects:
    - name: zmk
      remote: zmkfirmware
      revision: main
      import: app/west.yml
    - name: zmk-dongle-display
      remote: dongle
      revision: main
  self:
    path: config
```
